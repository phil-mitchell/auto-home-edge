## esp/main/Kconfig.projbuild
```kconfig
menu "Home"

    config ESP_WIFI_SSID
        string "WiFi SSID"
        default "myssid"
        help
            SSID (network name) for the example to connect to.

    config ESP_WIFI_PASSWORD
        string "WiFi Password"
        default "mypassword"
        help
            WiFi password (WPA or WPA2) for the example to use.

    config ESP_MAXIMUM_RETRY
        int "Maximum retry"
        default 5
        help
            Set the Maximum retry to avoid station reconnecting to the AP unlimited when the AP is really inexistent.

    config MQTT_BROKER_URL
        string "MQTT Broker URL"
        default "mqtt://mqtt.eclipse.org"
        help
            URL of the broker to connect to

    config AUTOHOME_API_URL
        string "MQTT Broker URL"
        default "https://home.brewingbeer.ca"
        help
            URL for AutoHome API access

    config AUTOHOME_API_KEY
        string "AutoHome API key"
        default ""
        help
            API key for AutoHome API access

    config AUTOHOME_HOME_GUID
        string "AutoHome Home GUID"
        default ""
        help
            Home GUID for autohome

    config AUTOHOME_ZONE_GUID
        string "AutoHome Zone GUID"
        default ""
        help
            Zome GUID for autohome
endmenu
```
